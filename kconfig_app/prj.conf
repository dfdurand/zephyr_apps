## CMakeLists.txt
```
# SPDX-License-Identifier: Apache-2.0

cmake_minimum_required(VERSION 3.20.0)

find_package(Zephyr REQUIRED HINTS $ENV{ZEPHYR_BASE})
project(kconfig_app)
if (CONFIG_BUILD_APP)
    target_sources(app PRIVATE src/main.c)
    message(" === building kconfig_app application for board: ${CONFIG_BOARD_TARGET} ===")
endif()
```

## Kconfig
```
#Kconfig - Configuration file for the Hello World sample application
config BUILD_APP
    bool "Build the application"
    default y
    depends on SOC_STM32G071XX || SOC_NRF52840 || SOC_STM32F446XX
    help
      If enabled, the application will be built.
      This is useful for testing and development purposes.

config APP_BLINK_LED
    bool "Enable LED blinking"
    default y
    help
      If enabled, the application will blink the LED.

config BLINK_DELAY
    int "LED blink delay in milliseconds"
    default 500
    range 100 5000
    help
      Delay between LED toggles in milliseconds.


source "Kconfig.zephyr"
```

## sample.yaml
```
# Sample YAML configuration for the Kconfig application
sample:
  name: blinky with custom delay
tests:
  sample.kconfig.blinky:
    tags:
      - gpio
    filter: dt_enabled_alias_with_parent_compat("led0", "gpio-leds")
    depends_on: gpio
    harness: led
    integration_platforms:
      - nucleo_g071rb
      - nrf52840dk/nrf52840
    platform_allow:
      - nucleo_g071rb
      - nrf52840dk/nrf52840


# west build -p -b nucleo_g071rb kconfig_app/
# west build -p -b nrf52840dk/nrf52840 kconfig_app
# GUI configuration:
#  - cd zephyr_apps/kconfig_app
#  - west build -p -b nucleo_g071rb -t menuconfig
#  - west build -p -b nrf52840dk/nrf52840 -t menuconfig
```

## prj.conf
```kconfig
CONFIG_GPIO=y
CONFIG_BUILD_APP=y
CONFIG_APP_BLINK_LED=y
# CONFIG_BLINK_DELAY=1000
```

## custom.conf
```kconfig
CONFIG_BLINK_DELAY=1000
```

## boards/nrf52840dk_nrf52840.conf
```kconfig
# CONFIG_BLINK_DELAY=100 
```

## boards/nucleo_g071rb.conf
```kconfig
CONFIG_BLINK_DELAY=100 
```

## src/main.c
```c
/*
 * Zephyr OS Sample Application: Kconfig Demonstration
 * Target board: NUCLEO-G071RBv1 and NRF52840DK
 */

#include <zephyr/kernel.h>
#include <zephyr/device.h>
#include <zephyr/devicetree.h>
#include <zephyr/drivers/gpio.h>

/* Configurable LED pin and delay via Kconfig */
#define LED0_NODE DT_ALIAS(led0)
#if !DT_NODE_HAS_STATUS(LED0_NODE, okay)
#error "Unsupported board: led0 devicetree alias is not defined"
#endif

static const struct gpio_dt_spec led = GPIO_DT_SPEC_GET(LED0_NODE, gpios);

/* Delay time is defined in Kconfig */
#define DELAY_TIME_MS CONFIG_BLINK_DELAY

int main(void)
{
    int ret;

    ret = gpio_pin_configure_dt(&led, GPIO_OUTPUT_ACTIVE);
    if (ret < 0) {
        return -1;
    } else {
        printk("LED configured successfully.\n");
        printf("target board used:  %s\n", CONFIG_BOARD_TARGET);
		
    }
#if CONFIG_APP_BLINK_LED
    while (1) {
        gpio_pin_toggle_dt(&led);
        k_msleep(DELAY_TIME_MS);
    }
#else
    printk("LED blinking is disabled\n");
#endif
    return 0;
}
```
