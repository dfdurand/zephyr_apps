/*
 * SPDX-License-Identifier: Apache-2.0
 */
/ {
    leds: leds {

        led0: led_0 {
			compatible = "es,led-gpio";
			gpios = <&gpio0 13 GPIO_ACTIVE_LOW>;
			label = "Green LED 0";
			blink-delay-ms = <2000>;
		};
    };

    aliases {
		led0 = &led0;
	};
};
