## CMakeLists.txt
```
# SPDX-License-Identifier: Apache-2.0

cmake_minimum_required(VERSION 3.20.0)
find_package(Zephyr REQUIRED HINTS $ENV{ZEPHYR_BASE})
project(logging_app)

target_sources(app PRIVATE src/main.c)
```

## sample.yaml
```
sample:
  name: Zephyr Logging Sample
  description: |
    This sample demonstrates how to use logging subsystem for zephyr OS 
  zephyr_apps.logging:
    tags:
      - logging
    integration_platforms:
      - nucleo_g071rb
      - nrf52840dk/nrf52840
    platform_allow:
      - nucleo_g071rb
      - nrf52840dk/nrf52840
```

## prj.conf
```kconfig
# Enable logging
CONFIG_LOG=y

CONFIG_LOG_DEFAULT_LEVEL=3

# Enable random generator number
CONFIG_TEST_RANDOM_GENERATOR=y



# CONFIG_LOG_DEFAULT_LEVEL=x     # Set default level to x (0=none, .. 3=info, 4=debug)
# CONFIG_LOG_MODE_IMMEDIATE=y
# CONFIG_LOG_MODE_DEFERRED=y   
```

## src/main.c
```c
#include <zephyr/kernel.h>
#include <zephyr/logging/log.h>
#include <zephyr/sys/printk.h>
#include <zephyr/random/random.h>

LOG_MODULE_REGISTER(temp_monitor, LOG_LEVEL_INF); // Change level if needed

#define TEMP_READ_INTERVAL_MS 2000
#define CRITICAL_TEMP_C 35

static int simulate_temperature_reading(void) {
    // Simulate temperature between 20°C and 40°C
    return 20 + (sys_rand32_get() % 21);
}

int main(void) {
    printk(" ===== Starting the monitor temperature ===== \n");

    while (1) {
        int temp = simulate_temperature_reading();

        //  printk version
        printk("printk >> measured temperature : %d°C\n", temp);

        //  Logging Subsystem version
        LOG_INF("LOG_INF >> measured temperature : %d°C", temp);

        if (temp > CRITICAL_TEMP_C - 3 && temp < CRITICAL_TEMP_C)  {
            LOG_WRN(" !!! almost reached critical temp (%d°C)", temp);
        }

        if (temp > CRITICAL_TEMP_C) {
            LOG_ERR("critical temperature! (%d°C)", temp);
        }

        k_msleep(TEMP_READ_INTERVAL_MS);
    }

}
```
