/ {
    zephyr,user {
        io-channels = <&adc1 0>;  // ADC1 channel 0 (PA0)
    };
};

&adc1 {
    #address-cells = <1>;
	#size-cells = <0>;

	channel@0 {
		reg = <0>;
		zephyr,gain = "ADC_GAIN_1";
		zephyr,reference = "ADC_REF_INTERNAL";
		zephyr,acquisition-time = <ADC_ACQ_TIME_DEFAULT>; /* Connect LM35 data pin to PA0 for Nucleo-G071RB */
		zephyr,resolution = <12>;
	};
    status = "okay";
};
