## adc_app/sample.yaml
```yaml
sample:
  name: adc application sample using Zephyr ADC API
  description: |
    This sample demonstrates how to use the ADC API in Zephyr to read LM35DZ analog values
    from a specified ADC channel. It configures the ADC, reads the value, and prints it
    to the console.
tests:
  zephyr_apps.adc:
    tags:
      - adc
    integration_platforms:
      - nucleo_g071rb
      - nrf52840dk/nrf52840
    platform_allow:
      - nucleo_g071rb
      - nrf52840dk/nrf52840
```

## binding_app/dts/bindings/es,led-gpio.yaml
```yaml
# SPDX-License-Identifier: Apache-2.0
title: Custom Blinky LED Binding

description: Custom binding for a GPIO-controlled LED with a configurable blink delay

compatible: "es,led-gpio"

# include: [base.yaml, gpio-controller.yaml]
include: [base.yaml]

properties:
  gpios:
    type: phandle-array
    required: true
    description: GPIO specifier for the LED

  label:
    type: string
    # required: true

  blink-delay-ms:
    type: int
    required: true
    description: Delay time in milliseconds between LED toggles
```

## binding_app/sample.yaml
```yaml
# Sample YAML configuration for the custom binding application
sample:
  name: blinky with custom delay
tests:
  sample.custom.blinky:
    tags:
      - gpio
    filter: dt_enabled_alias_with_parent_compat("led0", "gpio-leds")
    depends_on: gpio
    harness: led
    integration_platforms:
      - nucleo_g071rb
      - nrf52840dk/nrf52840
    platform_allow:
      - nucleo_g071rb
      - nrf52840dk/nrf52840
  
# commands to build the application for different platforms
# - west build -p -b nucleo_g071rb binding_app/
# - west build -p -b nrf52840dk/nrf52840 binding_app 
```

## tests/test_app/testcase.yaml
```yaml
tests:
  sample.testing.ztest:
    platform_allow: 
      - native_sim
    tags: ztest









# west build -p -b nucleo_g071rb  tests/test_app/
# west build -p -b native_sim     tests/test_app/ -t run
```

## tests/twister_demo/testcase.yaml
```yaml
common:
  depends_on: gpio
  tags:
    - drivers
    - gpio
  harness: ztest
tests:
  twister_demo.ztest:
    build_only: true
    platform_allow: 
      - native_sim
  twister_demo.all_boards:
    integration_platforms:
      - nucleo_g071rb
      - nrf52840dk/nrf52840
    platform_allow:
      - nucleo_g071rb
      - nrf52840dk/nrf52840
  twister_demo.stm32:
    filter: dt_alias_exists("led0") and  CONFIG_SOC_FAMILY_STM32
    integration_platforms:
      - nucleo_g071rb
  twister_demo.nrf:
    filter: dt_alias_exists("led0") and dt_compat_enabled("nordic,nrf-gpio")
    integration_platforms:
      - nrf52840dk/nrf52840
  twister_demo.fixture:
    harness_config:
      fixture: uart_fixture
    platform_allow:
      - nucleo_g071rb
      - nrf52840dk/nrf52840
    extra_configs:
      - CONFIG_UART_ASYNC_API=y
  twister_demo.conf_file:
    harness_config:
      fixture: i2c_fixture
    platform_allow:
      - nucleo_g071rb
      - nrf52840dk/nrf52840
    extra_args: EXTRA_CONF_FILE="i2c_fixture_overlay.conf"
```

## uart_dma/sample.yaml
```yaml
sample:
  name: uart communication in async mode
  description: |
    This sample application demonstrates the use of UART with DMA in Zephyr.
    It initializes the UART, sets up DMA for receiving and transmitting data, and handles UART events.
    The application continuously receives data from the UART and transmits a predefined message.
tests:
  zephyr_apps.uart_async:
    tags:
      - serial
      - uart
    filter: CONFIG_UART_ASYNC_API and
            dt_chosen_enabled("zephyr,shell-uart")
    harness: keyboard
    integration_platforms:
      - nucleo_g071rb
      - nrf52840dk/nrf52840
    platform_allow:
      - nucleo_g071rb
      - nrf52840dk/nrf52840
```
